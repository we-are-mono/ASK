## sdk/linux/drivers/net/ethernet/freescale/sdk_dpaa/Kconfig
```kconfig
menuconfig FSL_SDK_DPAA_ETH
	tristate "DPAA Ethernet"
	depends on (FSL_SOC || ARM64 || ARM) && FSL_SDK_BMAN && FSL_SDK_QMAN && FSL_SDK_FMAN && !FSL_DPAA_ETH
	select PHYLIB
	help
	  Data Path Acceleration Architecture Ethernet driver,
	  supporting the Freescale QorIQ chips.
	  Depends on Freescale Buffer Manager and Queue Manager
	  driver and Frame Manager Driver.

if FSL_SDK_DPAA_ETH

config FSL_DPAA_OFFLINE_PORTS
	bool "Offline Ports support"
	depends on FSL_SDK_DPAA_ETH
	default y
	help
	  The Offline Parsing / Host Command ports (short: OH ports, of Offline ports) provide
	  most of the functionality of the regular, online ports, except they receive their
	  frames from a core or an accelerator on the SoC, via QMan frame queues,
	  rather than directly from the network.
	  Offline ports are configured via PCD (Parse-Classify-Distribute) schemes, just like
	  any online FMan port. They deliver the processed frames to frame queues, according
	  to the applied PCD configurations.

	  Choosing this feature will not impact the functionality and/or performance of the system,
	  so it is safe to have it.

config FSL_DPAA_ADVANCED_DRIVERS
        bool "Advanced DPAA Ethernet drivers"
        depends on FSL_SDK_DPAA_ETH
        default y
        help
	  Besides the standard DPAA Ethernet driver the DPAA Proxy initialization driver
	  is needed to support advanced scenarios. Select this to also build the advanced
	  drivers.

config FSL_DPAA_ETH_JUMBO_FRAME
	bool "Receive a jumbo frame into one buffer"
	default n
	help
	  Size the Rx buffers for a whole 9.6K frame, so a jumbo frame is
	  received into one buffer rather than scattered across several.
	  The offload paths that re-inject or transform a frame (the SEC,
	  the fragmenter, Wi-Fi) take it in one buffer.
	  NOTE: This option can only be used if FSL_FM_MAX_FRAME_SIZE
	  is set to 9600 bytes.
	  The buffers are larger than a page and are carved from compound
	  pages, three to an order-3 page; the skb truesize follows the
	  frame length rather than the buffer size.

config FSL_DPAA_TS
	bool "Linux compliant timestamping"
	depends on FSL_SDK_DPAA_ETH
	default n
	help
	  Enable Linux API compliant timestamping support.

config FSL_DPAA_1588
        bool "IEEE 1588-compliant timestamping"
        depends on FSL_SDK_DPAA_ETH
        select FSL_DPAA_TS
        default n
        help
         Enable IEEE1588 support code.

config FSL_DPAA_ETH_MAX_BUF_COUNT
	int "Maximum number of buffers in the private bpool"
	depends on FSL_SDK_DPAA_ETH
	range 64 2048
	default "128"
	help
	  The maximum number of buffers to be by default allocated in the DPAA-Ethernet
	  private port's buffer pool per CPU per user (ports that share the same pool).
	  One needn't normally modify this, as it has probably been tuned for performance
	  already. This cannot be lower than DPAA_ETH_REFILL_THRESHOLD.

config FSL_DPAA_ETH_REFILL_THRESHOLD
	int "Private bpool refill threshold"
	depends on FSL_SDK_DPAA_ETH
	range 32 FSL_DPAA_ETH_MAX_BUF_COUNT
	default "80"
	help
	  The DPAA-Ethernet driver will start replenishing buffer pools whose count
	  falls below (buffer pool config count - this threshold)(for ethernet buffer case
	  config count is DPAA_ETH_MAX_BUF_COUNT). This parameter can also useful for other
	  buffer pools(vsp is using it). One needn't normally modify this value unless one
	  has very specific performance reasons.

config FSL_DPAA_CS_THRESHOLD_1G
	hex "Egress congestion threshold on 1G ports"
	depends on FSL_SDK_DPAA_ETH
	range 0x1000 0x10000000
	default "0x06000000"
	help
	  The size in bytes of the egress Congestion State notification threshold on 1G ports.
	  The 1G dTSECs can quite easily be flooded by cores doing Tx in a tight loop
	  (e.g. by sending UDP datagrams at "while(1) speed"),
	  and the larger the frame size, the more acute the problem.
	  So we have to find a balance between these factors:
	       - avoiding the device staying congested for a prolonged time (risking
                 the netdev watchdog to fire - see also the tx_timeout module param);
               - affecting performance of protocols such as TCP, which otherwise
	         behave well under the congestion notification mechanism;
	       - preventing the Tx cores from tightly-looping (as if the congestion
	         threshold was too low to be effective);
	       - running out of memory if the CS threshold is set too high.

config FSL_DPAA_CS_THRESHOLD_10G
	hex "Egress congestion threshold on 10G ports"
	depends on FSL_SDK_DPAA_ETH
	range 0x1000 0x20000000
	default "0x10000000"
	help
	  The size in bytes of the egress Congestion State notification threshold on 10G ports.

config FSL_DPAA_ETH_DEBUGFS
	bool "DPAA Ethernet debugfs interface"
	depends on DEBUG_FS && FSL_SDK_DPAA_ETH
	default y
	help
	  This option compiles debugfs code for the DPAA Ethernet driver.

endif # FSL_SDK_DPAA_ETH
```

## sdk/linux/drivers/net/ethernet/freescale/sdk_fman/Kconfig
```kconfig
menu "Frame Manager support"

menuconfig FSL_SDK_FMAN
	bool "Freescale Frame Manager (datapath) support - SDK driver"
	depends on (FSL_SOC || ARM64 || ARM) && FSL_SDK_BMAN && FSL_SDK_QMAN && !FSL_FMAN
	default y
	help
		If unsure, say Y.

if FSL_SDK_FMAN

config FSL_SDK_FMAN_EHASH_SYNC_FAULT
	bool "Fault injection for external-hash DeleteKey HC syncs"
	default n
	help
		Adds /proc/fm_ehash_hcsync_fail: writing a decimal N makes the
		next N host-command syncs issued inside ExternalHashTableDeleteKey,
		or for deferred unlinks by ExternalHashTableDeleteSync, report
		failure without touching hardware, so the
		unlinked-but-unsynced delete paths and their caller-side
		quarantine handling can be exercised deterministically.
		Test images only; never enable in production.

config FSL_FM_MAX_FRAME_SIZE
	int "Maximum L2 frame size"
	range 64 9600
	default "1522"
	help
		Configure this in relation to the maximum possible MTU of your
		network configuration. In particular, one would need to
		increase this value in order to use jumbo frames.
		FSL_FM_MAX_FRAME_SIZE must accommodate the Ethernet FCS (4 bytes)
		and one ETH+VLAN header (18 bytes), to a total of 22 bytes in
		excess of the desired L3 MTU.

		Note that having too large a FSL_FM_MAX_FRAME_SIZE (much larger
		than the actual MTU) may lead to buffer exhaustion, especially
		in the case of badly fragmented datagrams on the Rx path.
		Conversely, having a FSL_FM_MAX_FRAME_SIZE smaller than the actual
		MTU will lead to frames being dropped.

		This can be overridden by specifying "fsl_fm_max_frm" in
		the kernel bootargs:
		 * in Hypervisor-based scenarios, by adding a "chosen" node
		with the "bootargs" property specifying
		"fsl_fm_max_frm=<YourValue>";
		 * in non-Hypervisor-based scenarios, via u-boot's env, by
		modifying the "bootargs" env variable.

config FSL_FM_RX_EXTRA_HEADROOM
	int "Add extra headroom at beginning of data buffers"
	range 16 384
	default "64"
	help
		Configure this to tell the Frame Manager to reserve some extra
		space at the beginning of a data buffer on the receive path,
		before Internal Context fields are copied. This is in addition
		to the private data area already reserved for driver internal
		use. The provided value must be a multiple of 16.

		This setting can be overridden by specifying
		"fsl_fm_rx_extra_headroom" in the kernel bootargs:
		 * in Hypervisor-based scenarios, by adding a "chosen" node
		with the "bootargs" property specifying
		"fsl_fm_rx_extra_headroom=<YourValue>";
		 * in non-Hypervisor-based scenarios, via u-boot's env, by
		modifying the "bootargs" env variable.

endif # FSL_SDK_FMAN

endmenu
```
