## Kconfig
```kconfig
menuconfig NXP_ASK
	bool "NXP ASK hardware offloading modules"
	depends on FSL_SDK_DPAA_ETH
	help
	  NXP Application Solutions Kit (ASK) kernel modules for
	  data-plane acceleration on LS1046A and similar DPAA1 SoCs.

if NXP_ASK

config ASK_CDX
	tristate "CDX data-plane acceleration module"
	depends on FSL_SDK_FMAN
	help
	  Core data exchange module for ASK hardware offloading.

config ASK_FCI
	tristate "FCI fast control interface module"
	depends on ASK_CDX
	help
	  Fast Control Interface for CDX module management.

config ASK_AUTO_BRIDGE
	tristate "ASK auto-bridge module"
	depends on BRIDGE
	help
	  Automatic bridge offloading with VLAN filter support.

endif # NXP_ASK
```

## meta-ask/conf/layer.conf
```bitbake
BBPATH .= ":${LAYERDIR}"
BBFILES += "${LAYERDIR}/recipes-*/*/*.bb \
            ${LAYERDIR}/recipes-*/*/*.bbappend"

BBFILE_COLLECTIONS += "meta-ask"
BBFILE_PATTERN_meta-ask = "^${LAYERDIR}/"
BBFILE_PRIORITY_meta-ask = "15"

LAYERDEPENDS_meta-ask = "core openembedded-layer"
LAYERSERIES_COMPAT_meta-ask = "walnascar"

# Root of the ASK source tree — used by ask-modules / ask-userspace recipes
# as the externalsrc path so developers can iterate on uncommitted changes.
ASK_SRCROOT = "${LAYERDIR}/.."
```

## meta-ask/conf/machine/ask-ls1046a.conf
```bitbake
#@TYPE: Machine
#@NAME: ASK LS1046A test target
#@DESCRIPTION: LS1046A-based gateway used for ASK stack testing via netboot.

# CPU tuning
require conf/machine/include/arm/armv8a/tune-cortexa72.inc

MACHINE_FEATURES = "usbhost pci rtc serial"

SERIAL_CONSOLES = "115200;ttyS0"

# Kernel recipe provided by this layer.
PREFERRED_PROVIDER_virtual/kernel = "linux-ask"

KERNEL_IMAGETYPE ?= "Image.gz"
KERNEL_DEVICETREE = "freescale/mono-gateway-dk.dtb"

# Bundle the test initramfs directly into the kernel — one tftpboot file.
INITRAMFS_IMAGE = "ask-image"
INITRAMFS_IMAGE_NAME = "ask-image-${MACHINE}.rootfs"
INITRAMFS_IMAGE_BUNDLE = "1"
INITRAMFS_MAXSIZE = "536870912"
```
